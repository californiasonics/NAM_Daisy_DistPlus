// NAM_WaveNet_Daisy.ino - single-file WaveNet pedal for the Daisy Seed (Arduino IDE + DaisyDuino)
//
// Model: "MXR Distortion+ - Output300 Dist500" (Neural Amp Modeler, 3-channel, 48 kHz)
// Left input -> model -> both outputs.
//
// Arduino IDE:
//   Board: Electrosmith Daisy -> Daisy Seed      (needs the DaisyDuino library)
//   (The model code forces its own -O3, so the Tools > Optimize setting doesn't matter.)
//
// LED on = model loaded and running.
//
// The whole network, for one input sample `in`:
//
//   x = in * rechannel                          spread 1 input into C channels
//   for each layer:
//       z     = dilated_conv(x history) + bias  look back in time, mix channels
//             + mix * in                        the raw input is fed to every layer
//       z     = LeakyReLU(z)                    the nonlinearity
//       skip += z                               every layer contributes to the output
//       x     = x + out_mix(z) + out_bias       residual: pass x on, plus a correction
//   out = head_scale * (head_conv(skip history) + head_bias)
//
// The dilations grow 1, 3, 7, 17, 41, 101, 239, so 23 small layers can see
// thousands of samples of history. For speed, the code runs this 16 samples at a
// time, layer by layer. The weights are at the bottom of this file.

#include "DaisyDuino.h"

#define ENABLE_DCACHE 1  // data cache: big speed-up. If audio turns crackly/garbled, set to 0

// ---------------------------------------------------------------- model settings
namespace nam_model {
constexpr float kSampleRate  = 48000.0f;
constexpr int   kChannels    = 3;
constexpr int   kBottleneck  = 3;
constexpr int   kNumLayers   = 23;
constexpr int   kHeadKernel  = 16;
constexpr int   kActivation  = 0;   // 0 LeakyReLU, 1 ReLU, 2 Tanh
constexpr float kLeakySlope  = 0.01f;
constexpr int   kHistoryFrames = 6354;      // sum over layers of dilation*(kernel-1)+1
constexpr int   kNumWeights  = 1871;
constexpr int   kConvWeights = 1404;    // dilated-conv weights, all layers

constexpr int kKernelSizes[kNumLayers] = { 6, 6, 6, 6, 6, 6, 6, 6, 6, 6, 6, 6, 6, 6, 15, 15, 6, 6, 6, 6, 6, 6, 6 };
constexpr int kDilations[kNumLayers]   = { 1, 3, 7, 17, 41, 101, 239, 1, 3, 7, 17, 41, 101, 239, 1, 13, 1, 3, 7, 17, 41, 101, 239 };

extern const float kWeights[kNumWeights];   // defined at the end of the file
}  // namespace nam_model

// ---------------------------------------------------------------- the WaveNet
// Make the model code fast no matter what Tools > Optimize is set to
#pragma GCC push_options
#pragma GCC optimize("O3")

namespace wavenet {

const int C = nam_model::kChannels;      // channels between layers (3)
const int B = nam_model::kBottleneck;    // channels inside a layer (3)
const int NUM_LAYERS = nam_model::kNumLayers;
const int HEAD_TAPS = nam_model::kHeadKernel;
const int MAX_TAPS = 16;                 // largest kernel we allow
const int BLOCK = 16;                    // samples processed together, per layer
static_assert(C == 3 && B == 3, "process() is written out for 3 channels");
// History: each layer keeps dilation*(taps-1) old samples plus room for one block
const int HISTORY_FRAMES = nam_model::kHistoryFrames - NUM_LAYERS + NUM_LAYERS * BLOCK;

struct Layer
{
    int taps;                   // kernel size
    int dilation;               // spacing between taps, in samples
    float w[MAX_TAPS][B][C];    // conv weights  [tap][out][in]
    float bias[B];
    float mix[B];               // weight for the raw input sample
    float outW[C][B];           // 1x1 "out mix" back to C channels
    float outBias[C];

    // Circular buffer holding this layer's past inputs (C floats per sample)
    float* history;
    int length;                 // dilation * (taps - 1) + BLOCK samples
    int writePos;
};

class WaveNet
{
public:
    // Copy weights out of the flat array, in the order NAM stores them.
    bool load(const float* weights)
    {
        const float* w = weights;
        float* pool = historyPool;

        for (int c = 0; c < C; c++) rechannel[c] = *w++;

        for (int l = 0; l < NUM_LAYERS; l++)
        {
            Layer& L = layers[l];
            L.taps = nam_model::kKernelSizes[l];
            L.dilation = nam_model::kDilations[l];
            if (L.taps > MAX_TAPS) return false;

            for (int o = 0; o < B; o++)                 // NAM order: out, in, tap
                for (int i = 0; i < C; i++)
                    for (int k = 0; k < L.taps; k++)
                        L.w[k][o][i] = *w++;
            for (int o = 0; o < B; o++) L.bias[o] = *w++;
            for (int o = 0; o < B; o++) L.mix[o] = *w++;
            for (int o = 0; o < C; o++)
                for (int i = 0; i < B; i++)
                    L.outW[o][i] = *w++;
            for (int o = 0; o < C; o++) L.outBias[o] = *w++;

            L.length = L.dilation * (L.taps - 1) + BLOCK;
            L.history = pool;                           // carve a slice of the pool
            pool += L.length * C;
            L.writePos = 0;
        }

        for (int i = 0; i < B; i++)
            for (int k = 0; k < HEAD_TAPS; k++)
                headW[k][i] = *w++;
        headBias = *w++;
        headScale = *w++;

        clear();
        return (w - weights) == nam_model::kNumWeights;
    }

    void clear()
    {
        for (int i = 0; i < HISTORY_FRAMES * C; i++) historyPool[i] = 0.0f;
        for (int k = 0; k < HEAD_TAPS; k++)
            for (int i = 0; i < B; i++) headHistory[k][i] = 0.0f;
        for (int l = 0; l < NUM_LAYERS; l++) layers[l].writePos = 0;
        headPos = 0;
    }

    // Feed silence until the network settles (avoids a thump at power-up).
    void warmUp()
    {
        float zeros[BLOCK] = {0}, junk[BLOCK];
        for (int n = 0; n < nam_model::kHistoryFrames + HEAD_TAPS; n += BLOCK)
            processBlock(zeros, junk, BLOCK);
    }

    // Any number of samples: cut into blocks of up to BLOCK
    void process(const float* in, float* out, int n)
    {
        while (n > 0)
        {
            int m = n < BLOCK ? n : BLOCK;
            processBlock(in, out, m);
            in += m; out += m; n -= m;
        }
    }

    // One block of n <= BLOCK samples, layer by layer.
    // Written out by hand for 3 channels: every multiply-add is visible.
    void processBlock(const float* in, float* out, int n)
    {
        float x[BLOCK][3];      // signal flowing between layers
        float z[BLOCK][3];      // inside the current layer
        float skip[BLOCK][3];   // sum of every layer's output

        for (int t = 0; t < n; t++)
        {
            x[t][0] = rechannel[0] * in[t];
            x[t][1] = rechannel[1] * in[t];
            x[t][2] = rechannel[2] * in[t];
            skip[t][0] = skip[t][1] = skip[t][2] = 0.0f;
        }

        for (int l = 0; l < NUM_LAYERS; l++)
        {
            Layer& L = layers[l];

            // 1. Remember this block of the layer's input
            int pos = L.writePos;
            for (int t = 0; t < n; t++)
            {
                float* h = L.history + pos * 3;
                h[0] = x[t][0]; h[1] = x[t][1]; h[2] = x[t][2];
                if (++pos == L.length) pos = 0;
            }

            for (int t = 0; t < n; t++)
            {
                z[t][0] = L.bias[0] + L.mix[0] * in[t];
                z[t][1] = L.bias[1] + L.mix[1] * in[t];
                z[t][2] = L.bias[2] + L.mix[2] * in[t];
            }

            // 2. Dilated convolution. Taps are done two at a time: their 18
            //    weights stay in CPU registers while we sweep the whole block.
            const float* hEnd = L.history + L.length * 3;
            int k = 0;
            for (; k + 1 < L.taps; k += 2)
            {
                const float* wa = &L.w[k][0][0];
                const float* wb = &L.w[k + 1][0][0];
                const float a0 = wa[0], a1 = wa[1], a2 = wa[2], a3 = wa[3], a4 = wa[4],
                            a5 = wa[5], a6 = wa[6], a7 = wa[7], a8 = wa[8];
                const float b0 = wb[0], b1 = wb[1], b2 = wb[2], b3 = wb[3], b4 = wb[4],
                            b5 = wb[5], b6 = wb[6], b7 = wb[7], b8 = wb[8];
                const float* pa = pastFrame(L, (L.taps - 1 - k) * L.dilation);
                const float* pb = pastFrame(L, (L.taps - 2 - k) * L.dilation);
                for (int t = 0; t < n; t++)
                {
                    float z0 = z[t][0], z1 = z[t][1], z2 = z[t][2];
                    z0 += a0 * pa[0]; z0 += a1 * pa[1]; z0 += a2 * pa[2];
                    z1 += a3 * pa[0]; z1 += a4 * pa[1]; z1 += a5 * pa[2];
                    z2 += a6 * pa[0]; z2 += a7 * pa[1]; z2 += a8 * pa[2];
                    z0 += b0 * pb[0]; z0 += b1 * pb[1]; z0 += b2 * pb[2];
                    z1 += b3 * pb[0]; z1 += b4 * pb[1]; z1 += b5 * pb[2];
                    z2 += b6 * pb[0]; z2 += b7 * pb[1]; z2 += b8 * pb[2];
                    z[t][0] = z0; z[t][1] = z1; z[t][2] = z2;
                    pa += 3; if (pa == hEnd) pa = L.history;
                    pb += 3; if (pb == hEnd) pb = L.history;
                }
            }
            if (k < L.taps)                                  // odd tap count: last one
            {
                const float* w = &L.w[k][0][0];
                const float w0 = w[0], w1 = w[1], w2 = w[2], w3 = w[3], w4 = w[4],
                            w5 = w[5], w6 = w[6], w7 = w[7], w8 = w[8];
                const float* p = pastFrame(L, (L.taps - 1 - k) * L.dilation);
                for (int t = 0; t < n; t++)
                {
                    float z0 = z[t][0], z1 = z[t][1], z2 = z[t][2];
                    z0 += w0 * p[0]; z0 += w1 * p[1]; z0 += w2 * p[2];
                    z1 += w3 * p[0]; z1 += w4 * p[1]; z1 += w5 * p[2];
                    z2 += w6 * p[0]; z2 += w7 * p[1]; z2 += w8 * p[2];
                    z[t][0] = z0; z[t][1] = z1; z[t][2] = z2;
                    p += 3; if (p == hEnd) p = L.history;
                }
            }

            // 3. LeakyReLU, add to the skip sums, 4. residual update of x
            const float a = nam_model::kLeakySlope;
            for (int t = 0; t < n; t++)
            {
                float z0 = z[t][0], z1 = z[t][1], z2 = z[t][2];
                if (z0 < 0) z0 *= a;
                if (z1 < 0) z1 *= a;
                if (z2 < 0) z2 *= a;
                skip[t][0] += z0; skip[t][1] += z1; skip[t][2] += z2;
                x[t][0] += L.outBias[0] + L.outW[0][0] * z0 + L.outW[0][1] * z1 + L.outW[0][2] * z2;
                x[t][1] += L.outBias[1] + L.outW[1][0] * z0 + L.outW[1][1] * z1 + L.outW[1][2] * z2;
                x[t][2] += L.outBias[2] + L.outW[2][0] * z0 + L.outW[2][1] * z1 + L.outW[2][2] * z2;
            }

            L.writePos = pos;
        }

        // 5. Head: a short convolution over the last HEAD_TAPS skip sums
        for (int t = 0; t < n; t++)
        {
            headHistory[headPos][0] = skip[t][0];
            headHistory[headPos][1] = skip[t][1];
            headHistory[headPos][2] = skip[t][2];
            float y = headBias;
            int idx = headPos + 1;                               // oldest entry
            for (int k = 0; k < HEAD_TAPS; k++)
            {
                if (idx >= HEAD_TAPS) idx -= HEAD_TAPS;
                y += headW[k][0] * headHistory[idx][0] + headW[k][1] * headHistory[idx][1]
                   + headW[k][2] * headHistory[idx][2];
                idx++;
            }
            if (++headPos == HEAD_TAPS) headPos = 0;
            out[t] = headScale * y;
        }
    }

private:
    // Where the first sample of this block was, `lag` samples earlier
    const float* pastFrame(const Layer& L, int lag) const
    {
        int idx = L.writePos - lag;
        if (idx < 0) idx += L.length;
        return L.history + idx * 3;
    }

    Layer layers[NUM_LAYERS];
    float rechannel[C];
    float headW[HEAD_TAPS][B];
    float headHistory[HEAD_TAPS][B];
    float headBias, headScale;
    int headPos;
    float historyPool[HISTORY_FRAMES * C];   // ~89 KB for this model
};

} // namespace wavenet
#pragma GCC pop_options

// ---------------------------------------------------------------- Daisy audio
DaisyHardware hw;
wavenet::WaveNet net;          // global: ~97 KB, far too big for the stack
bool modelOk = false;

float inputGain  = 1.0f;       // NAM models are level-sensitive: try 0.5 .. 4
float outputGain = 1.0f;       // master volume after the model

void AudioCallback(float** in, float** out, size_t size)
{
    static float buf[256];
    int n = size > 256 ? 256 : (int)size;

    if (!modelOk)                                        // no model: pass the dry signal
    {
        for (int i = 0; i < n; i++) out[0][i] = out[1][i] = in[0][i];
        return;
    }

    for (int i = 0; i < n; i++) buf[i] = in[0][i] * inputGain;
    net.process(buf, buf, n);
    for (int i = 0; i < n; i++) out[0][i] = out[1][i] = buf[i] * outputGain;
}

void setup()
{
    // Flush tiny "denormal" numbers to zero, also inside the audio interrupt
    __set_FPSCR(__get_FPSCR() | (1UL << 24));
    FPU->FPDSCR |= (1UL << 24);

    SCB_EnableICache();                                  // run code from cache, not slow flash
#if ENABLE_DCACHE
    SCB_EnableDCache();
#endif

    pinMode(LED_BUILTIN, OUTPUT);

    hw = DAISY.init(DAISY_SEED, AUDIO_SR_48K);           // model was trained at 48 kHz

    modelOk = net.load(nam_model::kWeights);
    if (modelOk) net.warmUp();                           // settle, so no thump at start
    digitalWrite(LED_BUILTIN, modelOk ? HIGH : LOW);

    DAISY.begin(AudioCallback);
}

void loop()
{
}

// ---------------------------------------------------------------- weights
// Exported from the .nam file, in NAM's own order (read by WaveNet::load).
namespace nam_model {
const float kWeights[kNumWeights] = {
  -1.97985649f, 2.2043798f, 1.89990807f, 0.212864086f, -0.158190936f, 0.100681581f, -0.124673858f, 1.18668103f,
  0.510029137f, 0.132343486f, 0.0586003549f, -0.0541954301f, 0.114836805f, -1.34254277f, -0.688771784f, 0.036698699f,
  0.121068127f, 0.0612768866f, 0.274506241f, -1.08524358f, -0.602668166f, 0.212260216f, -0.0528744087f, 0.151229665f,
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  0.0196458362f, 0.0455987342f, -0.045609232f, -0.0400801003f, -0.0193069298f, -0.145695418f, 0.0188767482f
};
}  // namespace nam_model
